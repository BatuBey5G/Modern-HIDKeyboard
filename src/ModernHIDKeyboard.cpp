#include "ModernHIDKeyboard.h"

// ASCII to HID Mapping Table
const uint8_t ModernHIDKeyboard::HIDTable[] = { 0x00, 0x00, 0x00, 0x00, 0x00, 0x00, 0x00, 0x00, 0x2A, 0x00, 0x00, 0x00, 0x00,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 0x35, 127 };
const uint8_t ModernHIDKeyboard::modifierTable[] = { 0x00, 0x00, 0x00, 0x00, 0x00, 0x00, 0x00, 0x00, 0x00, 0x00, 0x00, 0x00, 0x00,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 0x00, SHIFT, SHIFT, SHIFT, SHIFT, SHIFT, SHIFT, SHIFT, SHIFT, SHIFT, 0x00, SHIFT, SHIFT, 0x00, 0x00, 0x00, 0x00, 0x00, 0x00, 0x00, 0x00, 0x00, 0x00, 0x00, 0x00, 0x00, SHIFT, 0x00, SHIFT, 0x00, SHIFT, SHIFT, SHIFT, SHIFT, SHIFT, SHIFT, SHIFT, SHIFT, SHIFT, SHIFT, SHIFT, SHIFT, SHIFT, SHIFT, SHIFT, SHIFT, SHIFT, SHIFT, SHIFT, SHIFT, SHIFT, SHIFT, SHIFT, SHIFT, SHIFT, SHIFT, SHIFT, SHIFT, 0x00, 0x00, 0x00, SHIFT, SHIFT, 0x00, 0x00, 0x00, 0x00, 0x00, 0x00, 0x00, 0x00, 0x00, 0x00, 0x00, 0x00, 0x00, 0x00, 0x00, 0x00, 0x00, 0x00, 0x00, 0x00, 0x00, 0x00, 0x00, 0x00, 0x00, 0x00, 0x00, 0x00, SHIFT, SHIFT, SHIFT, SHIFT, 0x00 };

ModernHIDKeyboard::ModernHIDKeyboard() {
  for (int i = 0; i < 8; i++) buf[i] = 0;
}

void ModernHIDKeyboard::begin() {
  Serial.end();
  Serial.begin(9600);
}

// STANDART TUSLAR (ASCII tablosuna girenler)
void ModernHIDKeyboard::pressKey(uint8_t modifier, uint8_t key) {
  uint8_t hidCode = HIDTable[key];
  if (hidCode == 0) return;
  this->buf[0] |= modifier;
  for (int i = 2; i < 8; i++) {
    if (this->buf[i] == hidCode) return;
    if (this->buf[i] == 0) { this->buf[i] = hidCode; break; }
  }
  Serial.write(this->buf, 8);
}

void ModernHIDKeyboard::pressKey(uint8_t key) {
  pressKey(modifierTable[key], key);
}

void ModernHIDKeyboard::releaseKey(uint8_t key) {
  uint8_t hidCode = HIDTable[key];
  this->buf[0] &= ~modifierTable[key];
  for (int i = 2; i < 8; i++) {
    if (this->buf[i] == hidCode) this->buf[i] = 0;
  }
  Serial.write(this->buf, 8);
}

// OZEL TUSLAR (ASCII tablosunu pas gecenler)
void ModernHIDKeyboard::pressSpecialKey(uint8_t modifier, uint8_t specialKey) {
  this->buf[0] |= modifier;
  for (int i = 2; i < 8; i++) {
    if (this->buf[i] == specialKey) return;
    if (this->buf[i] == 0) { this->buf[i] = specialKey; break; }
  }
  Serial.write(this->buf, 8);
}

void ModernHIDKeyboard::pressSpecialKey(uint8_t specialKey) {
  pressSpecialKey(0, specialKey);
}

void ModernHIDKeyboard::releaseSpecialKey(uint8_t specialKey) {
  for (int i = 2; i < 8; i++) {
    if (this->buf[i] == specialKey) this->buf[i] = 0;
  }
  Serial.write(this->buf, 8);
}

void ModernHIDKeyboard::releaseAll() {
  for (int i = 0; i < 8; i++) buf[i] = 0;
  Serial.write(this->buf, 8);
}

void ModernHIDKeyboard::print(char* sequence) { 
  int i = 0;
  while(sequence[i] != '\0') {
    pressKey(sequence[i]);
    releaseKey(sequence[i]);
    i++;
  }
}

void ModernHIDKeyboard::println(char* sequence) { 
  print(sequence);
  pressSpecialKey(0, ENTER);
  releaseSpecialKey(ENTER);
}
